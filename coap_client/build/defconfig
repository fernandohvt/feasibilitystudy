## coap_client/build/defconfig
```kconfig
CONFIG_EXAMPLE_WIFI_SSID="minhawifi"
CONFIG_EXAMPLE_WIFI_PASSWORD="minhasenha"
CONFIG_COAP_MBEDTLS_PKI=y
CONFIG_COAP_MBEDTLS_DEBUG=y
CONFIG_COAP_LOG_DEBUG=y
CONFIG_LWIP_IP4_REASSEMBLY=y
CONFIG_LWIP_IP6_REASSEMBLY=y
CONFIG_MBEDTLS_PSK_MODES=y
CONFIG_MBEDTLS_KEY_EXCHANGE_PSK=y
CONFIG_MBEDTLS_SSL_PROTO_DTLS=y
```
